#pragma once
#include "pcm_base64.h"
#include <cstring>

namespace ScoutWire {
inline constexpr char Prefix[]="SCOUT ";
inline constexpr size_t PrefixSize=sizeof(Prefix)-1;
inline constexpr char AudioPrefix[]="SCOUT {\"event\":\"audio.input\",\"pcm\":\"";
inline constexpr char AudioSuffix[]="\"}\n";
inline constexpr size_t AudioBytes=sizeof(AudioPrefix)-1+856+sizeof(AudioSuffix);

// The only variable bytes are generated by the bounded base64 encoder, whose
// alphabet needs no JSON escaping. No JSON tree or heap allocation per packet.
inline size_t audio_frame(char* out,size_t capacity,const uint8_t* pcm,size_t size) {
  if(!out || size>640 || (size && !pcm))return 0;
  const size_t encoded=(size+2)/3*4;
  const size_t bytes=sizeof(AudioPrefix)-1+encoded+sizeof(AudioSuffix)-1;
  if(capacity<=bytes)return 0;
  std::memcpy(out,AudioPrefix,sizeof(AudioPrefix)-1);
  size_t written=0;
  if(!PcmBase64::encode(out+sizeof(AudioPrefix)-1,encoded+1,written,pcm,size))return 0;
  std::memcpy(out+sizeof(AudioPrefix)-1+written,AudioSuffix,sizeof(AudioSuffix));
  return bytes;
}

// All callers serialize an entire message with output_mutex. The driver's
// 4096-byte ring accepts bounded items; short writes retain their unsent tail.
template<class Writer> bool bytes(const char* data,size_t size,Writer& write) {
  for(size_t pos=0;pos<size;) {
    const size_t count=size-pos>1024?1024:size-pos;
    int n=write(data+pos,count);
    if(n<=0 || size_t(n)>count)return false;
    pos+=size_t(n);
  }
  return true;
}
template<class Writer> bool frame(const char* data,size_t size,Writer& write) {
  if(bytes(data,size,write))return true;
  // Terminate a partial failed record before the next serialized message.
  // If the connection is still blocked this can fail too; never busy-spin.
  write("\n",1);return false;
}
template<class Writer> bool json(const char* data,size_t size,Writer& write) {
  const bool ok=bytes(Prefix,PrefixSize,write) && bytes(data,size,write);
  const bool ended=bytes("\n",1,write);
  return ok && ended;
}
}
